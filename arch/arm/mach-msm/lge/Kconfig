## arch/arm/mach-msm/lge/Kconfig
```kconfig
config MACH_LGE
	bool

menu "LGE Board Selection"
source "arch/arm/mach-msm/lge/Kconfig.board"
endmenu


menu "LGE Specific Patches"

config LGE_QFPROM_INTERFACE
	bool "Support qfprom interface"
	default n
	depends on MACH_LGE
	help
	  LGE QFPROM DRIVER.

config UPDATE_LCDC_LUT
	bool "Set initial Qualcomm LCDC lut"
	default n
	depends on MACH_LGE
	help
	  Set initial Qualcomm LCDC Look Up Table.

config LCD_KCAL
	bool "Interface to calibrate LCD color temperature"
	default n
	depends on MACH_LGE && UPDATE_LCDC_LUT
	help
	  Interface to calibrate LCD color temperature

config EARJACK_DEBUGGER
	bool "Earjack UART debugger support"
	depends on MACH_APQ8064_MAKO
	default n
	help
	  Saying Y here will support earjack type UART debugger cable

config LGE_CRASH_HANDLER
	tristate "Support LGE Crash Handler"
	depends on !S390 && !UML && HAVE_MEMBLOCK && MSM_DLOAD_MODE

config LGE_CRASH_HANDLER
    tristate "Support LGE Kernel Panic Handler"
    default n
    depends on MACH_LGE
    help
    LGE Error handler.

config LGE_HIDDEN_RESET
	tristate "LGE hidden reset"
	default n
	depends on MACH_LGE && LGE_CRASH_HANDLER
	help
	  Enables support for LGE hidden reset. For turn on this feature,
	  "echo 1 > /sys/module/lge_panic_handler/parameters/hreset_enable"
	  or "lge_panic_handler.hreset_enable=1" from cmdline.

config LGE_USES_SMD_DS_TTY
    bool "Explicitly use smd tty driver for DS"
    default n
    depends on MSM_SMD_TTY && MACH_LGE
    help
        In Qualcomm MSM8960, smd tty driver for ds(/dev/smd0) is not used.
        Say yes if this tty driver must be used on LGE device. This is used
        to connect smd channel in user space(for example, ATCMD processing).

# LG_BTUI : FX3_BT_bringup - kukdong.bae@lge.com [S]
config LGE_BLUESLEEP
    default n
    bool "MSM8x60 LGE Bluetooth LPM"
    depends on MACH_LGE
# LG_BTUI : FX3_BT_bringup - kukdong.bae@lge.com [E]

config LGE_LCD_TUNING
     bool "lcd_tuning"
	 default n
	 depends on MACH_LGE
	 help
		Support LCD tuning.

config LGE_QC_LCDC_LUT
     bool "Set initial Qualcomm LCDC lut"
         default n
         depends on MACH_LGE
         help
                Set initail Qualcomm LCDC Look Up Table.

config LGE_KCAL
     bool "Interface to calibrate LCD color temperature"
         default n
         depends on MACH_LGE
         help
                Interface to calibrate LCD color temperature

config LGE_KCAL_QLUT
     bool "Interface to calibrate LCD color temperature by QLUT"
         default n
         depends on MACH_LGE && LGE_QC_LCDC_LUT && LGE_KCAL
         help
                Interface to calibrate LCD color temperature by QLUT
endmenu

# [ wany.cho@lge.com
config LGE_WORKAROUND_SYNAPTICS
     bool "Enable the workaround regarding a Synaptics Ghost Finger issue"
         default n
         depends on MACH_LGE
         help
                Enable the workaround regarding a Synaptics Ghost Finger issue

config LGE_AFE_RECOVERY
     bool "Enable the feature to recover the ambiguous AFE state"
         default n
         depends on MACH_LGE
         help
                Enable the feature to recover the ambiguous AFE state
# ] wany.cho@lge.com
```

## arch/arm/mach-msm/lge/Kconfig.board
```kconfig
#
# Include the specific Kconfig file for LGE board
#

# fx3
source "arch/arm/mach-msm/lge/fx3/Kconfig"
```

## arch/arm/mach-msm/lge/fx3/Kconfig
```kconfig
config BOARD_HEADER_FILE
	string "LGE board specific header file name"
	default ""

config MACH_MSM8930_FX3
	depends on ARCH_MSM8930
	select MACH_LGE
	bool "MSM8930 FX3"
	help
	  Support for the LGE MSM8930 FX3 device.

config MACH_LGE_FX3_SPCS
	bool "LGE FX3 SPCS board"
	depends on MACH_MSM8930_FX3

config MACH_LGE_FX3_MPCS
	bool "LGE FX3 MPCS board"
	depends on MACH_MSM8930_FX3

config MACH_LGE_FX3_VZW
	bool "LGE FX3 VZW board"
	depends on MACH_MSM8930_FX3

config MACH_LGE_FX3_TMUS
	bool "LGE FX3 TMUS board"
	depends on MACH_MSM8930_FX3

config MACH_LGE_FX3_GLOBAL
	bool "LGE FX3 GLOBAL board"
	depends on MACH_MSM8930_FX3

config MACH_LGE_FX3_ATT
	bool "LGE FX3 AT&T board"
	depends on MACH_MSM8930_FX3

config MACH_LGE_FX3_EUR
	bool "LGE FX3 EUR board"
	depends on MACH_MSM8930_FX3
	
config MACH_LGE_F6_TMUS
	bool "LGE F6 TMUS board"
	depends on MACH_MSM8930_FX3	

config MACH_LGE_F6_VDF
	bool "LGE F6 VDF board"
	depends on MACH_MSM8930_FX3	

config MACH_LGE_F6_ORG
	bool "LGE F6 ORG board"
	depends on MACH_MSM8930_FX3	

config MACH_LGE_F6_OPEN
	bool "LGE F6 OPEN board"
	depends on MACH_MSM8930_FX3	

config MACH_LGE_F6_TMO
        bool "LGE F6 TMO board"
        depends on MACH_MSM8930_FX3

config MACH_LGE_F6_GLOBAL_COMMON
	bool "LGE F6 board"
	depends on MACH_MSM8930_FX3

config MACH_LGE_FX3_SPCSTRF
    bool "LGE FX3 TRF board"
    depends on MACH_MSM8930_FX3


config MACH_LGE_FX3_WCDMA_TRF_US
	bool "LGE FX3 WCDMA TRF US board"
	depends on MACH_MSM8930_FX3

config LGE_PM
	bool "LGE board"
	depends on MACH_MSM8930_FX3

config LGE_PM8038_KPJT
	bool "LGE FX3 SPCS board"
	depends on MACH_MSM8930_FX3

config MACH_LGE_FX3_CRK
	bool "LGE FX3 CRK board"
	depends on MACH_MSM8930_FX3

config MACH_LGE_L9II_COMMON
	bool "LGE L9II board"
	depends on MACH_MSM8930_FX3

config MACH_LGE_L9II_OPEN_EU
	bool "LGE L9II OPEN EU board"
	depends on MACH_MSM8930_FX3

config MACH_LGE_L9II_ORG
	bool "LGE L9II ORG board"
	depends on MACH_MSM8930_FX3
	
config MACH_LGE_L9II_VDF
	bool "LGE L9II VDF board"
	depends on MACH_MSM8930_FX3

config MACH_LGE_FX3Q_TMUS
	bool "LGE FX3Q TMUS board"
	depends on MACH_MSM8930_FX3
```

## arch/arm/mach-msm/lge/lgps9/Kconfig
```kconfig
config BOARD_HEADER_FILE
	string "LGE board specific header file name"
	default ""

config MACH_MSM8930_LGPS9
	depends on ARCH_MSM8930
	select MACH_LGE
	bool "MSM8930 LGPS9"
	help
	  Support for the LGE MSM8930 LGPS9 device.
```

## drivers/char/diag/Kconfig
```kconfig
menu "Diag Support"

config DIAG_CHAR
	tristate "char driver interface and diag forwarding to/from modem"
	default m
	depends on USB_G_ANDROID || USB_FUNCTION_DIAG || USB_QCOM_MAEMO
	depends on ARCH_MSM
	help
	 Char driver interface for diag user space and diag-forwarding to modem ARM and back.
	 This enables diagchar for maemo usb gadget or android usb gadget based on config selected.
endmenu

menu "DIAG traffic over USB"

config DIAG_OVER_USB
	bool "Enable DIAG traffic to go over USB"
        depends on ARCH_MSM
	default y
	help
	 This feature helps segregate code required for DIAG traffic to go over USB.
endmenu

# LGE_CHANGE
menu "SLATE Support"

config LGE_SLATE
	bool "Enable SLATE Key Logging message routing"
		depends on DIAG_OVER_USB
	default y
	help
	This feature helps decide whether slate key logging start message would be routed to apps or not.
endmenu


menu "SDIO support for DIAG"

config DIAG_SDIO_PIPE
	depends on MSM_SDIO_AL
	default y
	bool "Enable 9K DIAG traffic over SDIO"
	help
	 SDIO Transport Layer for DIAG Router
endmenu

menu "HSIC support for DIAG"

config DIAG_BRIDGE_CODE
	depends on USB_QCOM_DIAG_BRIDGE
	default y
	bool "Enable QSC/9K DIAG traffic over SMUX/HSIC"
	help
	 SMUX/HSIC Transport Layer for DIAG Router
endmenu

# LGE_CHANGE_S
menu "LGE DM APP Support"

config LGE_DM_APP
	bool "LGE DM APP Support"
	default n
	depends on MACH_LGE
	help
	 LGE DM APP Support
endmenu

menu "USB Diag Disable"

config LGE_USB_DIAG_DISABLE
	default n
	bool "Disable diag function"
	help
	 Provide method of diag enable or disable
endmenu

menu "USB Only MDM Diag Disable"

config LGE_USB_DIAG_DISABLE_ONLY_MDM
	default n
	bool "Disable Only MDM Diag function"
	help
	 Provide method of MDM diag enable or disable
endmenu

menu "LGE DIAG MTS Daemon Support"

config LGE_MTS
	bool "LGE Diag MTS Daemon Support"
	default n
	depends on MACH_LGE
	help
	 LGE DIAG MTS Support
endmenu

menu "LGE DIAG table update twice"  

config LGE_DIAG_TABLE_UPDATE_TWICE  
   bool "LGE DIAG table update twice"  
   default n  
   depends on MACH_LGE  
   help  
   LGE DIAG table twice  
endmenu 

menu "LGE USB LOCK for TRF"  

config LGE_USB_LOCK_TRF
   bool "LGE USB LOCK TRF enable"  
   default n  
   help  
   provice LGE USB LOCK for TRF
endmenu 
# LGE_CHANGE_E
```

## drivers/input/sensor/Kconfig
```kconfig
menuconfig INPUT_SENSOR
	bool "Sensor"
	help
	  Say Y here, and a list of supported Sensor will be displayed.
	  This option doesn't affect the kernel.

	  If unsure, say Y.

if INPUT_SENSOR

config SENSORS_AK8963
	tristate "AK8963 compass support"
	default n
	depends on I2C
	help
	 If you say yes here you get support for Asahi Kasei's orientation sensor AK8963.

config SENSORS_BMC150_COMMON
	bool
	default n

config SENSORS_BMA2X2
	tristate "BMA255/BMA250E/BMA222E/BMA280 acceleration sensor support"
	depends on I2C
	select SENSORS_BMC150_COMMON
	help
	  If you say yes here you get support for Bosch Sensortec's
	  acceleration sensors BMA255/BMA250E/BMA222E/BMA280.

config SENSORS_BMA250
	tristate "BMA250 Acceleration Sensor Driver"
	depends on I2C
	help
	 BMA250 Acceleration Sensor Driver implemented by Bosch-Sensortec.

config SENSORS_BMM050
	tristate "BMM050 Magnetic Sensor Driver"
	depends on I2C
	select SENSORS_BMC150_COMMON
	help
	 BMM050 Magnetic Sensor Driver implemented by Bosch-Sensortec.

config SENSORS_APDS9190
	tristate "APDS-9190 PROXIMITY Sensor Driver"
	depends on I2C
	help
	 APDS-9190 PROXIMITY Sensor Driver implemented by AVAGO Tech.

config SENSORS_APDS9130
	tristate "APDS-9130 PROXIMITY Sensor Driver"
	depends on I2C
	help
	 APDS-9130 PROXIMITY Sensor Driver implemented by AVAGO Tech.

endif
```

## drivers/switch/Kconfig
```kconfig
menuconfig SWITCH
	tristate "Switch class support"
	help
	  Say Y here to enable switch class support. This allows
	  monitoring switches by userspace via sysfs and uevent.

if SWITCH

config SWITCH_GPIO
	tristate "GPIO Swith support"
	depends on GENERIC_GPIO
	help
	  Say Y here to enable GPIO based switch support.

config SWITCH_FSA8008
	tristate "LGE Headset detection driver(FSA8080)"
	depends on MACH_LGE
	default n
	help
	  Say Y here to enable GPIO based switch support.

config LGE_AUDIO_MBHC_SDEV
	tristate "Switch device driver headset detection(MBHC)"
	depends on MACH_LGE
	default n
	help
	  Say Y here to enable Switch device driver headset detection(MBHC)

endif # SWITCH
```

## lge/factory/Kconfig
```kconfig
#platform.team@lge.com	2011.01

config LGE_FACTORY
	default y
	bool "LGE factory Configuration"
	help
		LGE factory Configuration

config LGE_DIAGTEST
	depends on LGE_FACTORY
	default y
	bool "LGE TestMode Diag Support"
	help
		LGE TestMode Diag Supports

config LGE_DLOAD_SRD
	depends on LGE_FACTORY
	default y
	bool "LGE Dload SelfRecoveryDownload Support"
	help
		LGE Dload SelfRecoveryDownload Support

config LGE_EMMC_DIRECT_ACCESS
	depends on LGE_DIAGTEST
	default y
	bool "LGE eMMC direct access driver"
	help
                LGE eMMC direct access driver
```
